## ruralreach_gateway/sdkconfig.defaults
```kconfig
# RuralReach gateway (ESP32-S3 + SX1262 + SIM800L) build defaults.
# After editing, regenerate with:  rm sdkconfig && idf.py set-target esp32s3 && idf.py build

# Target: Heltec WiFi LoRa 32 V3 (ESP32-S3)
CONFIG_IDF_TARGET="esp32s3"

# 8 MB flash, larger app partition
CONFIG_ESPTOOLPY_FLASHSIZE_8MB=y
CONFIG_PARTITION_TABLE_SINGLE_APP_LARGE=y
```

## ruralreach_node/sdkconfig.defaults
```kconfig
# RuralReach node bench-test defaults.
# Delete the generated `sdkconfig` after editing this file so these apply:
#   rm sdkconfig && idf.py set-target esp32s3 && idf.py build

# --- Target: Heltec WiFi LoRa 32 V3 is an ESP32-S3 ---
CONFIG_IDF_TARGET="esp32s3"

# --- Bluetooth Low Energy via NimBLE (ESP32-S3 has BLE only, no SPP) ---
CONFIG_BT_ENABLED=y
CONFIG_BT_NIMBLE_ENABLED=y
CONFIG_BT_CONTROLLER_ENABLED=y
CONFIG_BT_NIMBLE_ROLE_PERIPHERAL=y
CONFIG_BT_NIMBLE_ROLE_BROADCASTER=y
CONFIG_BT_NIMBLE_ROLE_CENTRAL=n
CONFIG_BT_NIMBLE_ROLE_OBSERVER=n

# --- Heltec WiFi LoRa 32 V3 has 8 MB flash; give the app room for BLE ---
CONFIG_ESPTOOLPY_FLASHSIZE_8MB=y
CONFIG_PARTITION_TABLE_SINGLE_APP_LARGE=y
```
